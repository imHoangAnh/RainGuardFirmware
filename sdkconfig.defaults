## sdkconfig.defaults
```kconfig
# ESP32-S3-WROOM N16R8 Configuration (16MB Flash, 8MB PSRAM Octal SPI)

# ESP32-S3 Specific
CONFIG_IDF_TARGET="esp32s3"

# PSRAM Configuration - Octal SPI Mode for N16R8
CONFIG_SPIRAM=y
CONFIG_SPIRAM_MODE_OCT=y
CONFIG_SPIRAM_SPEED_80M=y
CONFIG_SPIRAM_USE_MALLOC=y
CONFIG_SPIRAM_MALLOC_ALWAYSINTERNAL=16384

# Data Cache Configuration
CONFIG_ESP32S3_DATA_CACHE_16KB=y
CONFIG_ESP32S3_DATA_CACHE_LINE_16B=y

# Flash Configuration - 16MB, QIO Mode
CONFIG_ESPTOOLPY_FLASHSIZE_16MB=y
CONFIG_ESPTOOLPY_FLASHMODE_QIO=y
CONFIG_ESPTOOLPY_FLASHFREQ_80M=y

# Custom Partition Table
CONFIG_PARTITION_TABLE_CUSTOM=y
CONFIG_PARTITION_TABLE_CUSTOM_FILENAME="partitions.csv"
CONFIG_PARTITION_TABLE_FILENAME="partitions.csv"

# Camera and Image Processing
CONFIG_CAMERA_TASK_STACK_SIZE=4096

# HTTP Client
CONFIG_ESP_HTTP_CLIENT_ENABLE_HTTPS=y

# Wi-Fi Configuration
CONFIG_ESP_WIFI_STATIC_RX_BUFFER_NUM=16
CONFIG_ESP_WIFI_DYNAMIC_RX_BUFFER_NUM=32
CONFIG_ESP_WIFI_DYNAMIC_TX_BUFFER_NUM=32

# Compiler optimizations for performance
CONFIG_COMPILER_OPTIMIZATION_PERF=y
```
